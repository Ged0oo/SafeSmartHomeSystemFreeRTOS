# file: freeRTOS_temp.ioc
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FREERTOS.BinarySemaphores01=KeypadLcdSemaphore,Dynamic,NULL;FramesSemaphore,Dynamic,NULL
FREERTOS.Queues01=FramesQueue,5,uint8_t,0,Dynamic,NULL,NULL;ButtonsQueue,5,uint8_t,0,Dynamic,NULL,NULL;NumbersQueue,5,uint8_t,0,Dynamic,NULL,NULL
FREERTOS.Tasks01=setFrameTask,24,128,vSetFrameTask,Default,NULL,Dynamic,NULL,NULL;secondFrameTask,8,128,vSecondFrameTask,Default,NULL,Dynamic,NULL,NULL;keypadTask,40,128,vKeypadTask,Default,NULL,Dynamic,NULL,NULL;IntializationTa,41,128,vInitTask,Default,NULL,Dynamic,NULL,NULL
Mcu.Family=STM32F1
Mcu.Name=STM32F103C(8-B)Tx
Mcu.Package=LQFP48
NVIC.PriorityGroup=NVIC_PRIORITYGROUP_4
PD0-OSC_IN.Mode=HSE-External-Oscillator
PD0-OSC_IN.Signal=RCC_OSC_IN
PD1-OSC_OUT.Mode=HSE-External-Oscillator
PD1-OSC_OUT.Signal=RCC_OSC_OUT
ProjectManager.HeapSize=0x200
ProjectManager.StackSize=0x400
ProjectManager.TargetToolchain=STM32CubeIDE
RCC.AHBCLKDivider=RCC_SYSCLK_DIV2
RCC.AHBFreq_Value=8000000
RCC.APB1CLKDivider=RCC_HCLK_DIV4
RCC.APB1Freq_Value=2000000
RCC.APB1TimFreq_Value=4000000
RCC.APB2Freq_Value=8000000
RCC.APB2TimFreq_Value=8000000
RCC.HCLKFreq_Value=8000000
RCC.PLLSourceVirtual=RCC_PLLSOURCE_HSE
RCC.SYSCLKFreq_VALUE=16000000
RCC.SYSCLKSource=RCC_SYSCLKSOURCE_PLLCLK
RCC.USBFreq_Value=16000000
VP_FREERTOS_VS_CMSIS_V2.Mode=CMSIS_V2
board=custom

// file: Core/Src/main.c
/* USER CODE BEGIN Header */
/**
  ******************************************************************************
  * @file           : main.c
  * @brief          : Main program body
  ******************************************************************************
  * @attention
  *
  * Copyright (c) 2023 STMicroelectronics.
  * All rights reserved.
  *
  * This software is licensed under terms that can be found in the LICENSE file
  * in the root directory of this software component.
  * If no LICENSE file comes with this software, it is provided AS-IS.
  *
  ******************************************************************************
  */
/* USER CODE END Header */

#include "main.h"
#include "cmsis_os.h"
#include "gpio.h"

void SystemClock_Config(void);
void MX_FREERTOS_Init(void);

int main(void)
{

  /* MCU Configuration--------------------------------------------------------*/

  /* Reset of all peripherals, Initializes the Flash interface and the Systick. */

	HAL_Init();

  /* USER CODE BEGIN Init */

	MRCC_voidClockInit(&RCC_obj);
	MRCC_voidPeripheralClockEnable(RCC_APB2_BUS , RCC_GPIOA_CLOCK);
	MRCC_voidPeripheralClockEnable(RCC_APB2_BUS , RCC_GPIOB_CLOCK);

  /* USER CODE END Init */

  /* Configure the system clock */

	SystemClock_Config();

  /* Initialize all configured peripherals */
  MX_GPIO_Init();

  /* Init scheduler */
  osKernelInitialize();  /* Call init function for freertos objects (in freertos.c) */
  MX_FREERTOS_Init();

  /* Start scheduler */
  osKernelStart();

  /* We should never get here as control is now taken by the scheduler */
  /* Infinite loop */
  while (1)
  {

  }
}

void SystemClock_Config(void)
{

  RCC_OscInitTypeDef RCC_OscInitStruct = {0};
  RCC_ClkInitTypeDef RCC_ClkInitStruct = {0};

  /** Initializes the RCC Oscillators according to the specified parameters
  * in the RCC_OscInitTypeDef structure.
  */
  RCC_OscInitStruct.OscillatorType = RCC_OSCILLATORTYPE_HSE;
  RCC_OscInitStruct.HSEState = RCC_HSE_ON;
  RCC_OscInitStruct.HSEPredivValue = RCC_HSE_PREDIV_DIV1;
  RCC_OscInitStruct.HSIState = RCC_HSI_ON;
  RCC_OscInitStruct.PLL.PLLState = RCC_PLL_ON;
  RCC_OscInitStruct.PLL.PLLSource = RCC_PLLSOURCE_HSE;
  RCC_OscInitStruct.PLL.PLLMUL = RCC_PLL_MUL2;
  if (HAL_RCC_OscConfig(&RCC_OscInitStruct) != HAL_OK)
  {
    Error_Handler();
  }

  /** Initializes the CPU, AHB and APB buses clocks
  */
  RCC_ClkInitStruct.ClockType = RCC_CLOCKTYPE_HCLK|RCC_CLOCKTYPE_SYSCLK
                              |RCC_CLOCKTYPE_PCLK1|RCC_CLOCKTYPE_PCLK2;
  RCC_ClkInitStruct.SYSCLKSource = RCC_SYSCLKSOURCE_PLLCLK;
  RCC_ClkInitStruct.AHBCLKDivider = RCC_SYSCLK_DIV2;
  RCC_ClkInitStruct.APB1CLKDivider = RCC_HCLK_DIV4;
  RCC_ClkInitStruct.APB2CLKDivider = RCC_HCLK_DIV1;

  if (HAL_RCC_ClockConfig(&RCC_ClkInitStruct, FLASH_LATENCY_0) != HAL_OK)
  {
    Error_Handler();
  }
}

void Error_Handler(void)
{
  __disable_irq();
  while (1)
  {
  }
}

// file: Core/Src/freertos.c
/* USER CODE BEGIN Header */
/**
  ******************************************************************************
  * File Name          : freertos.c
  * Description        : Code for freertos applications
  ******************************************************************************
  * @attention
  *
  * Copyright (c) 2023 STMicroelectronics.
  * All rights reserved.
  *
  * This software is licensed under terms that can be found in the LICENSE file
  * in the root directory of this software component.
  * If no LICENSE file comes with this software, it is provided AS-IS.
  *
  ******************************************************************************
  */
/* USER CODE END Header */

#include "FreeRTOS.h"
#include "task.h"
#include "main.h"
#include "cmsis_os.h"

/* USER CODE BEGIN Includes */
#include "LCD_interface.h"
#include "queue.h"

/* USER CODE END Includes */

/* USER CODE BEGIN PD */

#define IncrementButton			'A'
#define DecrementButton			'C'
#define ChoiceButton			'B'

#define NUMBERS_DATA    		0
#define BUTTONS_DATA 			1

#define STAGE_ONE				1
#define STAGE_TWO				2

#define FIRST_FRAME         	1
#define SECOND_FRAME         	2
#define THIRD_FRAME       		3
#define FOURTH_FRAME        	4
#define FIFTH_FRAME        		5

/* USER CODE END PD */

/* USER CODE BEGIN Variables */

uint8_t keypadVal = NOTPRESSED;
uint8_t tries = 3;
uint16_t adminPassword = 1111;
uint8_t systemLockFlag = 0;

uint8_t CurrentData;
uint8_t secondFrameFlag = 0;

uint8_t CurrentFrame = FIRST_FRAME;

uint8_t *FirstScreenFrames[6][2] =
{
		{"**  Mood One  **",	"*  Temprature  *"},
		{"**  Mood Two  **",	"* AirCondition *"},
		{"*  Mood Three  *",	"*  Lighetning  *"},
		{"*  Mood  Four  *",	"**  Humadity  **"},
		{"*  Mood  Five  *",	"* GasDetection *"}
};

uint8_t *ScoundScreenFrames[6][2] =
{
		{"Temperature Mode",	"Temprature => 27"},
		{"AirConditionMode",	"AirCondition=>NO"},
		{" Lightning Mode ",	"Lights are => ON"},
		{"* HumadityMood *",	"Humadity =>  83%"},
		{"**  Gas Mood  **",	"GasDetecte => NO"}
};

/* USER CODE END Variables */
/* Definitions for setFrameTask */
osThreadId_t setFrameTaskHandle;
const osThreadAttr_t setFrameTask_attributes = {
  .name = "setFrameTask",
  .stack_size = 128 * 4,
  .priority = (osPriority_t) osPriorityNormal,
};
/* Definitions for secondFrameTask */
osThreadId_t secondFrameTaskHandle;
const osThreadAttr_t secondFrameTask_attributes = {
  .name = "secondFrameTask",
  .stack_size = 128 * 4,
  .priority = (osPriority_t) osPriorityLow,
};
/* Definitions for keypadTask */
osThreadId_t keypadTaskHandle;
const osThreadAttr_t keypadTask_attributes = {
  .name = "keypadTask",
  .stack_size = 128 * 4,
  .priority = (osPriority_t) osPriorityHigh,
};
/* Definitions for IntializationTa */
osThreadId_t IntializationTaHandle;
const osThreadAttr_t IntializationTa_attributes = {
  .name = "IntializationTa",
  .stack_size = 128 * 4,
  .priority = (osPriority_t) osPriorityHigh1,
};
/* Definitions for FramesQueue */
osMessageQueueId_t FramesQueueHandle;
const osMessageQueueAttr_t FramesQueue_attributes = {
  .name = "FramesQueue"
};
/* Definitions for ButtonsQueue */
osMessageQueueId_t ButtonsQueueHandle;
const osMessageQueueAttr_t ButtonsQueue_attributes = {
  .name = "ButtonsQueue"
};
/* Definitions for NumbersQueue */
osMessageQueueId_t NumbersQueueHandle;
const osMessageQueueAttr_t NumbersQueue_attributes = {
  .name = "NumbersQueue"
};
/* Definitions for KeypadLcdSemaphore */
osSemaphoreId_t KeypadLcdSemaphoreHandle;
const osSemaphoreAttr_t KeypadLcdSemaphore_attributes = {
  .name = "KeypadLcdSemaphore"
};
/* Definitions for FramesSemaphore */
osSemaphoreId_t FramesSemaphoreHandle;
const osSemaphoreAttr_t FramesSemaphore_attributes = {
  .name = "FramesSemaphore"
};

/* USER CODE BEGIN FunctionPrototypes */

void GetPassword();
void PutWelcommingMessegae();
void LcdSetFrame(uint8_t stage, uint8_t frame);

/* USER CODE END FunctionPrototypes */

void vSetFrameTask(void *argument);
void vSecondFrameTask(void *argument);
void vKeypadTask(void *argument);
void vInitTask(void *argument);

void MX_FREERTOS_Init(void); /* (MISRA C 2004 rule 8.1) */

void MX_FREERTOS_Init(void)
{

  /* creation of IntializationTa */
  IntializationTaHandle = osThreadNew(vInitTask, NULL, &IntializationTa_attributes);

}

void vSetFrameTask(void *argument)
{
  /* USER CODE BEGIN vSetFrameTask */
	BaseType_t RetVal = pdTRUE;
	uint8_t QueueDirection;
	/* Infinite loop */
	for(;;)
	{
		RetVal= xQueueReceive(ButtonsQueueHandle, &QueueDirection, 0);

		if(QueueDirection == IncrementButton)
		{
			if(CurrentFrame == FIFTH_FRAME)
				CurrentFrame = FIRST_FRAME;
			else CurrentFrame++;
			LcdSetFrame(STAGE_ONE, CurrentFrame);
		}

		else if(QueueDirection == DecrementButton)
		{
			if(CurrentFrame == FIRST_FRAME)
				CurrentFrame = FIFTH_FRAME;
			else CurrentFrame-- ;
			LcdSetFrame(STAGE_ONE, CurrentFrame);
		}

		else if(QueueDirection == ChoiceButton)
		{
			secondFrameFlag ^= 1;
			RetVal = xQueueSendToFront(FramesQueueHandle, (void *)&CurrentFrame, HAL_MAX_DELAY);
			osSemaphoreAcquire(FramesSemaphoreHandle, HAL_MAX_DELAY);
		}

		osSemaphoreRelease(KeypadLcdSemaphoreHandle);
	}
  /* USER CODE END vSetFrameTask */
}

void vSecondFrameTask(void *argument)
{
  /* USER CODE BEGIN vSecondFrameTask */
	BaseType_t RetVal = pdTRUE;
	uint8_t message = 0;
	uint8_t QueueDirection;
	uint8_t choice = 0;
	/* Infinite loop */
	for(;;)
	{
		RetVal= xQueueReceive(FramesQueueHandle, &message, HAL_MAX_DELAY);

		if(pdTRUE == RetVal)
		{
			if(secondFrameFlag)
			{
				LcdSetFrame(STAGE_TWO, message);
			}
			else
			{
				LcdSetFrame(STAGE_ONE, message);
			}
		}

		osSemaphoreRelease(FramesSemaphoreHandle);
	}
  /* USER CODE END vSecondFrameTask */
}

void vKeypadTask(void *argument)
{
  /* USER CODE BEGIN vKeypadTask */
	BaseType_t RetVal = pdTRUE;
	/* Infinite loop */
	for(;;)
	{
		keypadVal = NOTPRESSED;
		keypadVal = read_keypad(&keypad_1);
		if(keypadVal != NOTPRESSED)
		{
			if(keypadVal<'1' || keypadVal>'9')
			{
				CurrentData = BUTTONS_DATA;
				RetVal = xQueueSendToFront(ButtonsQueueHandle, (void *)&keypadVal, HAL_MAX_DELAY);
			}

			osSemaphoreAcquire(KeypadLcdSemaphoreHandle, HAL_MAX_DELAY);
		}

	}
  /* USER CODE END vKeypadTask */
}

void vInitTask(void *argument)
{
	/* USER CODE BEGIN vInitTask */
	/* Infinite loop */
	for(;;)
	{
		lcd_4bit_intialize(&lcd_1);
		keypad_initialize(&keypad_1);

		PutWelcommingMessegae();

		if(0 == systemLockFlag)
		{
			while((tries) && (0 == systemLockFlag)) GetPassword();
		}

		if((0 == tries) && (0 == systemLockFlag))
		{
			LCD_Clear(&lcd_1);
			lcd_4bit_send_string_pos(&lcd_1, 1, 1, "**   ERROR!   **");
			HAL_Delay(200);
			lcd_4bit_send_string_pos(&lcd_1, 2, 2, "System Locked");
			HAL_Delay(200);
			while(1);
		}
		else
		{
			  KeypadLcdSemaphoreHandle = osSemaphoreNew(1, 1, &KeypadLcdSemaphore_attributes);
			  FramesSemaphoreHandle = osSemaphoreNew(1, 1, &FramesSemaphore_attributes);
			  FramesQueueHandle = osMessageQueueNew (5, sizeof(uint8_t), &FramesQueue_attributes);
			  ButtonsQueueHandle = osMessageQueueNew (5, sizeof(uint8_t), &ButtonsQueue_attributes);
			  NumbersQueueHandle = osMessageQueueNew (5, sizeof(uint8_t), &NumbersQueue_attributes);
			  setFrameTaskHandle = osThreadNew(vSetFrameTask, NULL, &setFrameTask_attributes);
			  secondFrameTaskHandle = osThreadNew(vSecondFrameTask, NULL, &secondFrameTask_attributes);
			  keypadTaskHandle = osThreadNew(vKeypadTask, NULL, &keypadTask_attributes);
			  IntializationTaHandle = osThreadNew(vInitTask, NULL, &IntializationTa_attributes);
			  LcdSetFrame(STAGE_ONE, CurrentFrame);
			  vTaskSuspend(IntializationTaHandle);
		}
	}
	/* USER CODE END vInitTask */
}

/* USER CODE BEGIN Application */

void LcdSetFrame(uint8_t stage, uint8_t frame)
{
	frame--;
	switch(stage)
	{
		case STAGE_ONE :
			lcd_4bit_send_string_pos(&lcd_1, 1, 1, FirstScreenFrames[frame][0]);
			lcd_4bit_send_string_pos(&lcd_1, 2, 1, FirstScreenFrames[frame][1]);
			break;

		case STAGE_TWO :
			lcd_4bit_send_string_pos(&lcd_1, 1, 1, ScoundScreenFrames[frame][0]);
			lcd_4bit_send_string_pos(&lcd_1, 2, 1, ScoundScreenFrames[frame][1]);
			break;
	}
}

void PutWelcommingMessegae()
{
	LCD_Clear(&lcd_1);
	lcd_4bit_send_string_pos(&lcd_1, 1, 6, "Hello");
	HAL_Delay(200);
	lcd_4bit_send_string_pos(&lcd_1, 2, 5, "Welcome");
	HAL_Delay(500);
}

void GetPassword()
{
	uint8_t passLength = 4, digit=0;
	uint16_t password=0;

	LCD_Clear(&lcd_1);
	lcd_4bit_send_string_pos(&lcd_1, 1, 2, "Admin Password");
	HAL_Delay(500);

	while(passLength)
	{
		keypadVal = NOTPRESSED;
		keypadVal = read_keypad(&keypad_1);
		if(keypadVal != NOTPRESSED)
		{
			digit = keypadVal-'0';
			password = (password*10) + digit;

			lcd_4bit_send_char_data_pos(&lcd_1, 2, (4-passLength)+7, keypadVal);
			HAL_Delay(150);
			lcd_4bit_send_char_data_pos(&lcd_1, 2, (4-passLength)+7, '*');
			HAL_Delay(150);

			passLength--;
		}
	}

	if(password == adminPassword)
	{
		systemLockFlag = 1;

		LCD_Clear(&lcd_1);
		lcd_4bit_send_string_pos(&lcd_1, 1, 6, "Hello");
		HAL_Delay(200);

		lcd_4bit_send_string_pos(&lcd_1, 2, 4, "You are in");
		HAL_Delay(500);
	}
	else
	{
		systemLockFlag = 0;
		tries--;

		LCD_Clear(&lcd_1);
		lcd_4bit_send_string_pos(&lcd_1, 1, 1, "* WrongPassword *");
		HAL_Delay(200);

		if(0 == tries) lcd_4bit_send_string_pos(&lcd_1, 2, 2, "No Tries Left");
		else
		{
			lcd_4bit_send_string_pos(&lcd_1, 2, 1, "* Tries Left ");
			LCD_WriteNumber_Position(tries, 2, 14);
			lcd_4bit_send_string_pos(&lcd_1, 2, 15, " *");
		}

		HAL_Delay(1000);
	}
}

/* Task to be created. */

/* USER CODE END Application */
